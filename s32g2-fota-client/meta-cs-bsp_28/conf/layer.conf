## s32g2-fota-client/meta-cs-bsp_28/conf/layer.conf
```bitbake
# We have a conf and classes directory, add to BBPATH
BBPATH .= ":${LAYERDIR}"

# We have recipes-* directories, add to BBFILES
BBFILES += "${LAYERDIR}/recipes-*/*/*.bb \
            ${LAYERDIR}/recipes-*/*/*.bbappend"

BBFILE_COLLECTIONS += "meta-cs-bsp_28"
BBFILE_PATTERN_meta-cs-bsp_28 = "^${LAYERDIR}/"
BBFILE_PRIORITY_meta-cs-bsp_28 = "6"

LAYERDEPENDS_meta-cs-bsp_28 = "core"
LAYERSERIES_COMPAT_meta-cs-bsp_28 = "gatesgarth"
```

## s32g2-fota-client/meta-cs-vnp_v1/conf/layer.conf
```bitbake
# We have a conf and classes directory, add to BBPATH
BBPATH .= ":${LAYERDIR}"

# We have recipes-* directories, add to BBFILES
BBFILES += "${LAYERDIR}/recipes-*/*/*.bb \
            ${LAYERDIR}/recipes-*/*/*.bbappend"

BBFILE_COLLECTIONS += "meta-cs-vnp_v1"
BBFILE_PATTERN_meta-cs-vnp_v1 = "^${LAYERDIR}/"
BBFILE_PRIORITY_meta-cs-vnp_v1 = "6"

LAYERDEPENDS_meta-cs-vnp_v1 = "core"
LAYERSERIES_COMPAT_meta-cs-vnp_v1 = "gatesgarth"
```
